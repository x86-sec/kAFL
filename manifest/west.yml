## manifest/west.yml
```yaml
# West manifest for multi-repo management
#
# Configure custom branches and keep track in a repo of your choice.
#
# By default, west checks out a detached HEAD to avoid touching any local branches.
# To work on sub-projects, pull/extend branches as you like and use west update -k:
# https://docs.zephyrproject.org/latest/guides/west/built-in.html#west-update
#

manifest:

  remotes:
    - name: github
      url-base: https://github.com
    - name: gitlab
      url-base: https://gitlab.com

  # put manifest repo at $(west topdir)
  # only works with `west init -l`
  self:
    path: .
    import: manifest/imports/

  projects:

    # import all from kAFL
    - name: kafl
      remote: github
      repo-path: IntelLabs/kAFL
      revision: master
      import: manifest/west.yml

    # add more components / fuzzing targets here..
```
